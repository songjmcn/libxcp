ASAP2_VERSION 1 61
/begin PROJECT leaffix ""
/begin MODULE LEAF_FIX "batch18 negative fixture"
/begin MOD_COMMON "" BYTE_ORDER MSB_LAST ALIGNMENT_BYTE 1 ALIGNMENT_WORD 1 ALIGNMENT_LONG 1 ALIGNMENT_FLOAT32_IEEE 1 ALIGNMENT_FLOAT64_IEEE 1 ALIGNMENT_INT64 1 /end MOD_COMMON
/begin TYPEDEF_MEASUREMENT FM_U8 "fixture u8" UBYTE NO_COMPU_METHOD 0 0 0 255 /end TYPEDEF_MEASUREMENT
/begin TYPEDEF_MEASUREMENT FM_U32 "fixture u32" ULONG NO_COMPU_METHOD 0 0 0 4294967295 /end TYPEDEF_MEASUREMENT
/begin TYPEDEF_MEASUREMENT FM_U64 "fixture u64 width unknown to resolver" A_UINT64 NO_COMPU_METHOD 0 0 0 1000000000000 /end TYPEDEF_MEASUREMENT
/begin TYPEDEF_STRUCTURE OkHolder "positive control" 0x4 /begin STRUCTURE_COMPONENT ok FM_U8 0x0 /end STRUCTURE_COMPONENT /begin STRUCTURE_COMPONENT ghost MissingType 0x1 /end STRUCTURE_COMPONENT /begin STRUCTURE_COMPONENT wide FM_U64 0x2 /end STRUCTURE_COMPONENT /end TYPEDEF_STRUCTURE
/begin TYPEDEF_STRUCTURE LoopA "recursive A" 0x4 /begin STRUCTURE_COMPONENT inner LoopB 0x0 /end STRUCTURE_COMPONENT /begin STRUCTURE_COMPONENT v1 FM_U8 0x2 /end STRUCTURE_COMPONENT /end TYPEDEF_STRUCTURE
/begin TYPEDEF_STRUCTURE LoopB "recursive B" 0x4 /begin STRUCTURE_COMPONENT back LoopA 0x0 /end STRUCTURE_COMPONENT /begin STRUCTURE_COMPONENT v2 FM_U8 0x2 /end STRUCTURE_COMPONENT /end TYPEDEF_STRUCTURE
/begin TYPEDEF_STRUCTURE Outer "cycle host" 0x8 /begin STRUCTURE_COMPONENT cyc LoopA 0x0 /end STRUCTURE_COMPONENT /begin STRUCTURE_COMPONENT tail FM_U8 0x4 /end STRUCTURE_COMPONENT /end TYPEDEF_STRUCTURE
/begin TYPEDEF_STRUCTURE Oversize "out of range member" 0x2 /begin STRUCTURE_COMPONENT big FM_U32 0x0 /end STRUCTURE_COMPONENT /end TYPEDEF_STRUCTURE
/begin INSTANCE ok_ctrl "control single" OkHolder 0x2000 ECU_ADDRESS_EXTENSION 1 READ_WRITE /end INSTANCE
/begin INSTANCE h_ref "instance of unknown typedef" NoSuchType 0x3000 ECU_ADDRESS_EXTENSION 1 READ_WRITE /end INSTANCE
/begin INSTANCE zero_dim "MATRIX_DIM contains zero" OkHolder 0x4000 ECU_ADDRESS_EXTENSION 1 MATRIX_DIM 0 READ_WRITE /end INSTANCE
/begin INSTANCE big_dim "MATRIX_DIM over expand cap" OkHolder 0x5000 ECU_ADDRESS_EXTENSION 1 MATRIX_DIM 100000 READ_WRITE /end INSTANCE
/begin INSTANCE cyc "recursive cycle host" Outer 0x6000 ECU_ADDRESS_EXTENSION 1 READ_WRITE /end INSTANCE
/begin INSTANCE oob "out of range host" Oversize 0x7000 ECU_ADDRESS_EXTENSION 1 READ_WRITE /end INSTANCE
/end MODULE
/end PROJECT
